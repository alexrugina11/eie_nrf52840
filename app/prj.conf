## prj.conf
```kconfig
# Copyright (c) 2021 Nordic Semiconductor ASA
# SPDX-License-Identifier: Apache-2.0
#
# This file contains selected Kconfig options for the application.

CONFIG_GPIO=y
CONFIG_PWM=y
CONFIG_SMF=y
<<<<<<< HEAD

=======
>>>>>>> 04b671780342e4c799ea3c565aaf47354aee2dda
```

## src/main.c
```c
/*
 * main.c
 */

#include <zephyr/kernel.h>
#include <zephyr/sys/printk.h>
#include <inttypes.h>

#include <zephyr/kernel.h>
#include <zephyr/sys/printk.h>

#include "BTN.h"
#include "LED.h"
#include "BTN.h"

#define SLEEP_TIME_MS 1

int main(void) {

    if (0 > LED_init()) {
        return 0;
    }
    if (0 > BTN_init()) {
        return 0;
    }

    uint8_t current_duty_cycle = 0;

    LED_pwm(LED0, current_duty_cycle);

    while (1) {
        if (BTN_check_clear_pressed(BTN0)) {
            current_duty_cycle = (current_duty_cycle >= 100) ? 0 : (current_duty_cycle + 10);
            printk("Setting LED0 to %d%% brightness.\n", current_duty_cycle);
            LED_pwm(LED0, current_duty_cycle);
        }
        k_msleep(SLEEP_TIME_MS);
    }

    return 0;
}
```

## src/my_state_machine.c
```c
/**
 * @file my_state_machine.c
 */

#include <zephyr/smf.h>
#include "LED.h"
#include "my_state_machine.h"

/*---------------------------------------------------------
 * Function Prototypes
 *---------------------------------------------------------*/
static void led_on_state_exit(void *o);
static enum smf_state_result led_on_state_run(void *o);
static void led_off_state_exit(void *o);
static enum smf_state_result led_off_state_run(void *o);

/*---------------------------------------------------------
 * Typedefs
 *---------------------------------------------------------*/
enum led_state_machine_states {
    LED_ON_STATE,
    LED_OFF_STATE
};

typedef struct {
    // Context variable used by Zephyr to track state machine state. Must be first
    struct smf_ctx ctx;
    uint16_t count;
} led_state_object_t;

/*---------------------------------------------------------
 * Local Variables
 *---------------------------------------------------------*/
static const struct smf_state led_states[] = {
    [LED_ON_STATE]  = SMF_CREATE_STATE(NULL, led_on_state_run, led_on_state_exit, NULL, NULL),
    [LED_OFF_STATE] = SMF_CREATE_STATE(NULL, led_off_state_run, led_off_state_exit, NULL, NULL)
};

static led_state_object_t led_state_object;

void state_machine_init(void) {
    led_state_object.count = 0;
    smf_set_initial(SMF_CTX(&led_state_object), &led_states[LED_ON_STATE]);
}

int state_machine_run(void) {
    return smf_run_state(SMF_CTX(&led_state_object));
}

static void led_on_state_exit(void *o) {
    LED_set(LED0, LED_ON);
}

static enum smf_state_result led_on_state_run(void *o) {
    if (led_state_object.count > 500) {
        led_state_object.count = 0;
        smf_set_state(SMF_CTX(&led_state_object), &led_states[LED_OFF_STATE]);
    } else {
        led_state_object.count++;
    }

    return SMF_EVENT_HANDLED;
}

static void led_off_state_exit(void *o) {
    LED_set(LED0, LED_OFF);
}

static enum smf_state_result led_off_state_run(void *o) {
    if (led_state_object.count > 500) {
        led_state_object.count = 0;
        smf_set_state(SMF_CTX(&led_state_object), &led_states[LED_ON_STATE]);
    } else {
        led_state_object.count++;
    }

    return SMF_EVENT_HANDLED;
}
```
